/dts-v1/;
/plugin/;

/ {
    compatible = "brcm,bcm2835";

    fragment@0 {
        target-path = "/soc/mmc@7e300000";
        __overlay__ {
            status = "disabled";
        };
    };

    fragment@1 {
        target-path = "/soc/mmcnr@7e300000";
        __overlay__ {
            status = "disabled";
        };
    };
};
